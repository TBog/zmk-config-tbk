## Kconfig
```kconfig
config TBOG_LOCK_INDICATOR
    bool "TBog Lock indicator"
    select ZMK_HID_INDICATORS
    default y
    depends on DT_HAS_TBOG_LOCK_INDICATOR_ENABLED
```

## boards/shields/tbk_destaggered_tkl/Kconfig.defconfig
```kconfig
# Copyright (c) 2021 The ZMK Contributors
# SPDX-License-Identifier: MIT


if SHIELD_TBK_DESTAGGERED_TKL_LEFT

config ZMK_KEYBOARD_NAME
    default "TBK destaggered"

config ZMK_SPLIT_ROLE_CENTRAL
    default y

endif

if SHIELD_TBK_DESTAGGERED_TKL_LEFT || SHIELD_TBK_DESTAGGERED_TKL_RIGHT

config ZMK_SPLIT
    default y

endif
```

## boards/shields/tbk_destaggered_tkl/Kconfig.shield
```kconfig
# Copyright (c) 2021 The ZMK Contributors
# SPDX-License-Identifier: MIT


config SHIELD_TBK_DESTAGGERED_TKL_LEFT
    def_bool $(shields_list_contains,tbk_destaggered_tkl_left)

config SHIELD_TBK_DESTAGGERED_TKL_RIGHT
    def_bool $(shields_list_contains,tbk_destaggered_tkl_right)
```

## boards/shields/tbk_split_tkl/Kconfig.defconfig
```kconfig
# Copyright (c) 2021 The ZMK Contributors
# SPDX-License-Identifier: MIT


if SHIELD_TBK_SPLIT_TKL_LEFT

config ZMK_KEYBOARD_NAME
    default "TBK split-tkl"

config ZMK_SPLIT_ROLE_CENTRAL
    default y

endif

if SHIELD_TBK_SPLIT_TKL_LEFT || SHIELD_TBK_SPLIT_TKL_RIGHT

config ZMK_SPLIT
    default y

endif
```

## boards/shields/tbk_split_tkl/Kconfig.shield
```kconfig
# Copyright (c) 2021 The ZMK Contributors
# SPDX-License-Identifier: MIT


config SHIELD_TBK_SPLIT_TKL_LEFT
    def_bool $(shields_list_contains,tbk_split_tkl_left)

config SHIELD_TBK_SPLIT_TKL_RIGHT
    def_bool $(shields_list_contains,tbk_split_tkl_right)
```

## west.yml
```yaml
manifest:
  remotes:
    - name: zmkfirmware
      url-base: https://github.com/zmkfirmware
    - name: elpekenin
      url-base: https://github.com/elpekenin
    - name: tbog
      url-base: https://github.com/TBog
  projects:
    - name: zmk
      remote: zmkfirmware
      revision: main          
      import: app/west.yml
    - name: zmk-userspace
      remote: tbog
      revision: main
  self:
    path: config
```
